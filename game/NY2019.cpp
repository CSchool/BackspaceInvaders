#pragma GCC optimize ("-O3")

#include "libgame.h"
#include "graphics.h"
#include "binary.h"
#include "controls.h"
#include "music.h"
#include "tunes.h"

#ifdef FRAME_BUFFER

const uint8_t spriteLines[] PROGMEM = {
0x00, 0x00, 0x00, 0x00, 0x00, 0x00, 0x00, 0x00, 0x66, 0x66, 0x66, 0x66,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 0x00,
0x00, 0x00, 0x00, 0x00, 0x00, 0x00, 0x00, 0x00, 0x00, 0x00, 0x00, 0x00,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 0x00,
0x00, 0x00, 0x00, 0x00, 0x00, 0x00, 0x00, 0x00, 0x00, 0x00, 0x00, 0x00,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 0x00,
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0x12, 0x12, 0x12, 0x12, 0x00, 0x00, 0x00, 0x00, 0x00, 0x00, 0x00, 0x00,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 0x12,
};

const game_color_sprite sprite PROGMEM = {64, 61, spriteLines};

#define T_LENGTH 64
#define T_WIDTH 49
const uint8_t trajectory[T_LENGTH] PROGMEM = {24, 26, 28, 30, 33, 35, 37, 39, 40, 42, 43, 45, 46,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 19, 21};

#define SNOW 64

struct NY2019Data
{
    int8_t snowX[SNOW];
    int8_t snowY[SNOW];
    int8_t snowColor[SNOW];
    int8_t snowSpeedX[SNOW];
    int8_t snowSpeedY[SNOW];
    int8_t snowPhase[SNOW];
    int8_t winePhase;
    int8_t tonguePhase;
};
static NY2019Data* data;

void generateSnow(int i)
{
    int c = rand() % 3;
    int color = BLUE;
    if (c == 1)
        color = CYAN;
    else if (c == 2)
        color = WHITE;
    data->snowColor[i] = color;
    data->snowX[i] = rand() % WIDTH;
    data->snowY[i] = 0;
    data->snowSpeedX[i] = rand() % 2 + 1;
    data->snowSpeedY[i] = rand() % 4 + 1;
    data->snowPhase[i] = rand() % T_LENGTH;
}

static void NY2019_prepare()
{
    game_set_ups(8);
    game_enable_frame_buffer();
    game_draw_color_sprite(&sprite, 0, 3);
#ifndef EMULATED
    tune_init(stardragon_hall_of_fame_addr());
    tune_enable();
#endif

    for (int i = 0 ; i < SNOW ; ++i)
    {
        generateSnow(i);
        data->snowY[i] = rand() % HEIGHT;
    }
    data->winePhase = 0;
    data->tonguePhase = 0;
}

static void NY2019_render()
{
    // snowflakes
    for (int i = 0 ; i < SNOW ; ++i)
    {
        game_draw_pixel(data->snowX[i], data->snowY[i], data->snowColor[i]);
    }
    // wine
    int wineX = data->winePhase / 2;
    if (wineX == 3)
        wineX = 1;
    game_draw_rect(wineX + 48, 37, 3, 1, 0x15);
    // tongue
    int tongueX = data->tonguePhase / 10;
    game_draw_rect(tongueX + 33, 46, 2, 2, 0x51);
}

static void NY2019_update(unsigned long delta)
{
    for (int i = 0 ; i < SNOW ; ++i)
    {
        int x = data->snowX[i];
        int y = data->snowY[i];
        y += data->snowSpeedY[i];
        x -= pgm_read_byte(&trajectory[data->snowPhase[i]]);
        data->snowPhase[i] = (data->snowPhase[i] + data->snowSpeedX[i]) % T_LENGTH;
        x += pgm_read_byte(&trajectory[data->snowPhase[i]]);
        data->snowX[i] = x;
        data->snowY[i] = y;

        if (y >= HEIGHT)
        {
            generateSnow(i);
        }
    }
    data->winePhase = (data->winePhase + 1) % (4 * 2);
    data->tonguePhase = (data->tonguePhase + 1) % (2 * 10);
}

const game_instance NY2019 PROGMEM = {
    "NY2019",
    NY2019_prepare,
    NY2019_render,
    NY2019_update,
    sizeof(NY2019Data),
    (void**)(&data)
};

#endif
